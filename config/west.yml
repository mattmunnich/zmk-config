## config/west.yml
```yaml
manifest:
  remotes:
    - name: zmkfirmware
      url-base: https://github.com/zmkfirmware
    - name: nmunnich
      url-base: https://github.com/nmunnich
    - name: caksoylar 
      url-base: https://github.com/caksoylar
    - name: joelspadin
      url-base: https://github.com/joelspadin
    - name: urob
      url-base: https://github.com/urob
    # Additional modules containing boards/shields/custom code can be listed here as well
    # See https://docs.zephyrproject.org/3.2.0/develop/west/manifest.html#projects
  projects:
    - name: zmk
      remote: zmkfirmware
      revision: v0.3
      import: app/west.yml
    - name: zmk-apiaster-modules
      remote: nmunnich
      revision: main
    - name: zmk-rgbled-widget 
      remote: caksoylar
      revision: main
    - name: zmk-locales
      remote: joelspadin
      revision: main
    - name: zmk-unicode
      remote: urob
      revision: main
  self:
    path: config
```
